/*
*
* Copyright (c) 2021 Polarity Works
* SPDX-License-Identifier: MIT
*
*/

#define HOST_OS 1
#include "../zmk-nodefree-config/helper.h"
#include "../zmk-nodefree-config/international_chars/danish.dtsi"

#include "adv360.keymap"
